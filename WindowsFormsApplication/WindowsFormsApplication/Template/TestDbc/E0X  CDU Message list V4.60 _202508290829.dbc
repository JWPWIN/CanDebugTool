VERSION ""

NS_ :

BS_:

BU_: CDU

BO_ 520 BMS_2: 48 Vector__XXX
 SG_ BMS_2_CRC2 : 71|8@0+ (1,0) [0|255] ""  CDU
 SG_ BMS_2_RollgCntr2 : 75|4@0+ (1,0) [0|14] ""  CDU
 SG_ BMS_2_Resd2 : 79|4@0+ (1,0) [0|15] ""  CDU
 SG_ BMS_NV_relay_Sts : 84|3@0+ (1,0) [0|6] ""  CDU
 SG_ BMS_PV_relay_Sts : 87|3@0+ (1,0) [0|6] ""  CDU
 SG_ BMS_QCP_relay_Sts : 90|3@0+ (1,0) [0|6] ""  CDU
 SG_ BMS_QCN_relay_Sts : 93|3@0+ (1,0) [0|6] ""  CDU

BO_ 811 BMS_6: 16 Vector__XXX
 SG_ BMSH_CHGPrechargeRelaySts : 121|2@0+ (1,0) [0|3] ""  CDU

BO_ 1127 CDU_DCDC_1: 24 CDU
 SG_ CDU_1_CRC1 : 7|8@0+ (1,0) [0|255] "" Vector__XXX
 SG_ CDU_1_RollgCntr1 : 11|4@0+ (1,0) [0|14] "" Vector__XXX
 SG_ CDU_1_Resd1 : 15|4@0+ (1,0) [0|15] "" Vector__XXX
 SG_ DCDC_HvVolt : 23|16@0+ (0.1,0) [0|1000] "V" Vector__XXX
 SG_ DCDC_HVCurr : 39|16@0+ (0.1,0) [0|1000] "A" Vector__XXX
 SG_ DCDC_FaultCode : 55|8@0+ (1,0) [0|255] "" Vector__XXX
 SG_ CDU_1_CRC2 : 71|8@0+ (1,0) [0|255] "" Vector__XXX
 SG_ CDU_1_RollgCntr2 : 75|4@0+ (1,0) [0|14] "" Vector__XXX
 SG_ CDU_1_Resd2 : 79|4@0+ (1,0) [0|15] "" Vector__XXX
 SG_ DCDC_LvSideCurr : 87|12@0+ (1,0) [0|510] "A" Vector__XXX
 SG_ DCDC_LvSideVolt : 103|11@0+ (0.1,0) [0|25.3] "V" Vector__XXX
 SG_ DCDC_FaultLevelSts : 107|3@0+ (1,0) [0|7] "" Vector__XXX
 SG_ DCDC_EnableSts : 104|1@0+ (1,0) [0|1] "" Vector__XXX
 SG_ DCDC_OverTemp : 88|1@0+ (1,0) [0|1] "" Vector__XXX
 SG_ DCDC_LvSideCurrMax : 119|12@0+ (1,0) [0|510] "A" Vector__XXX
 SG_ DCDCFlowReq : 151|8@0+ (0.1,0) [0|25.5] "L/min" Vector__XXX

BO_ 1182 CDU_OBC_3: 48 CDU
 SG_ CDU_2_CRC1 : 7|8@0+ (1,0) [0|255] "" Vector__XXX
 SG_ CDU_2_RollgCntr1 : 11|4@0+ (1,0) [0|14] "" Vector__XXX
 SG_ CDU_2_Resd1 : 15|4@0+ (1,0) [0|15] "" Vector__XXX
 SG_ OBC_ChgCurr : 23|16@0+ (0.05,0) [0|400] "A" Vector__XXX
 SG_ OBC_ChgVolt : 39|16@0+ (0.05,0) [0|1000] "V" Vector__XXX
 SG_ OBC_MaxOutputPower : 55|8@0+ (0.1,0) [0|25.5] "kW" Vector__XXX
 SG_ OBC_FaultCode : 63|8@0+ (1,0) [0|255] "" Vector__XXX
 SG_ CDU_2_CRC2 : 71|8@0+ (1,0) [0|255] "" Vector__XXX
 SG_ CDU_2_RollgCntr2 : 75|4@0+ (1,0) [0|14] "" Vector__XXX
 SG_ CDU_2_Resd2 : 79|4@0+ (1,0) [0|15] "" Vector__XXX
 SG_ OBC_CP_DutyCycleValue : 87|8@0+ (1,0) [0|100] "%" Vector__XXX
 SG_ CDU_Coolanttemp : 95|8@0+ (1,-40) [-40|213] "oC" Vector__XXX
 SG_ OBC_ChgInterfaceTemp : 103|8@0+ (1,-40) [-40|213] "oC" Vector__XXX
 SG_ OBC_MaxDisOutPower : 111|8@0+ (0.1,0) [0|25.5] "kW" Vector__XXX
 SG_ OBC_CPMaxVolt : 119|8@0+ (0.1,0) [0|20] "V" Vector__XXX
 SG_ CDU_2_CRC3 : 135|8@0+ (1,0) [0|255] "" Vector__XXX
 SG_ CDU_2_RollgCntr3 : 139|4@0+ (1,0) [0|14] "" Vector__XXX
 SG_ CDU_2_Resd3 : 143|4@0+ (1,0) [0|15] "" Vector__XXX
 SG_ OBC_ChrgrInputCurr1 : 151|10@0+ (0.1,0) [0|100] "A" Vector__XXX
 SG_ OBC_ChrgrInputCurr2 : 157|10@0+ (0.1,0) [0|100] "A" Vector__XXX
 SG_ OBC_ChrgrInputCurr3 : 163|10@0+ (0.1,0) [0|100] "A" Vector__XXX
 SG_ OBC_S2Swtsts : 169|2@0+ (1,0) [0|3] "" Vector__XXX

BA_ "GenSigASIL" SG_ 520 BMS_2_CRC2 5;
BA_ "GenSigASIL" SG_ 520 BMS_2_RollgCntr2 5;
BA_ "GenSigASIL" SG_ 520 BMS_2_Resd2 5;
BA_ "GenSigASIL" SG_ 520 BMS_NV_relay_Sts 2;
BA_ "GenSigASIL" SG_ 520 BMS_PV_relay_Sts 2;
BA_ "GenSigASIL" SG_ 520 BMS_QCP_relay_Sts 2;
BA_ "GenSigASIL" SG_ 520 BMS_QCN_relay_Sts 2;
BA_ "GenSigASIL" SG_ 811 BMSH_CHGPrechargeRelaySts 5;
BA_ "GenSigASIL" SG_ 1127 CDU_1_CRC1 5;
BA_ "GenSigASIL" SG_ 1127 CDU_1_RollgCntr1 5;
BA_ "GenSigASIL" SG_ 1127 CDU_1_Resd1 5;
BA_ "GenSigASIL" SG_ 1127 DCDC_HvVolt 5;
BA_ "GenSigASIL" SG_ 1127 DCDC_HVCurr 5;
BA_ "GenSigASIL" SG_ 1127 DCDC_FaultCode 5;
BA_ "GenSigASIL" SG_ 1127 CDU_1_CRC2 5;
BA_ "GenSigASIL" SG_ 1127 CDU_1_RollgCntr2 5;
BA_ "GenSigASIL" SG_ 1127 CDU_1_Resd2 5;
BA_ "GenSigASIL" SG_ 1127 DCDC_LvSideCurr 5;
BA_ "GenSigASIL" SG_ 1127 DCDC_LvSideVolt 2;
BA_ "GenSigASIL" SG_ 1127 DCDC_FaultLevelSts 2;
BA_ "GenSigASIL" SG_ 1127 DCDC_EnableSts 5;
BA_ "GenSigASIL" SG_ 1127 DCDC_OverTemp 5;
BA_ "GenSigASIL" SG_ 1127 DCDC_LvSideCurrMax 5;
BA_ "GenSigASIL" SG_ 1127 DCDCFlowReq 5;
BA_ "GenSigASIL" SG_ 1182 CDU_2_CRC1 5;
BA_ "GenSigASIL" SG_ 1182 CDU_2_RollgCntr1 5;
BA_ "GenSigASIL" SG_ 1182 CDU_2_Resd1 5;
BA_ "GenSigASIL" SG_ 1182 OBC_ChgCurr 1;
BA_ "GenSigASIL" SG_ 1182 OBC_ChgVolt 1;
BA_ "GenSigASIL" SG_ 1182 OBC_MaxOutputPower 1;
BA_ "GenSigASIL" SG_ 1182 OBC_FaultCode 5;
BA_ "GenSigASIL" SG_ 1182 CDU_2_CRC2 5;
BA_ "GenSigASIL" SG_ 1182 CDU_2_RollgCntr2 5;
BA_ "GenSigASIL" SG_ 1182 CDU_2_Resd2 5;
BA_ "GenSigASIL" SG_ 1182 OBC_CP_DutyCycleValue 5;
BA_ "GenSigASIL" SG_ 1182 CDU_Coolanttemp 5;
BA_ "GenSigStartValue" SG_ 1182 CDU_Coolanttemp 40;
BA_ "GenSigASIL" SG_ 1182 OBC_ChgInterfaceTemp 5;
BA_ "GenSigStartValue" SG_ 1182 OBC_ChgInterfaceTemp 40;
BA_ "GenSigASIL" SG_ 1182 OBC_MaxDisOutPower 5;
BA_ "GenSigASIL" SG_ 1182 OBC_CPMaxVolt 5;
BA_ "GenSigASIL" SG_ 1182 CDU_2_CRC3 5;
BA_ "GenSigASIL" SG_ 1182 CDU_2_RollgCntr3 5;
BA_ "GenSigASIL" SG_ 1182 CDU_2_Resd3 5;
BA_ "GenSigASIL" SG_ 1182 OBC_ChrgrInputCurr1 5;
BA_ "GenSigASIL" SG_ 1182 OBC_ChrgrInputCurr2 5;
BA_ "GenSigASIL" SG_ 1182 OBC_ChrgrInputCurr3 5;
BA_ "GenSigASIL" SG_ 1182 OBC_S2Swtsts 5;
VAL_ 520 BMS_NV_relay_Sts 6 "OpenLoad" 5 "SCG" 4 "SCB" 3 "Stuck Closed" 2 "Stuck Open" 1 "closed" 0 "open" ;
VAL_ 520 BMS_PV_relay_Sts 6 "OpenLoad" 5 "SCG" 4 "SCB" 3 "Stuck Closed" 2 "Stuck Open" 1 "closed" 0 "open" ;
VAL_ 520 BMS_QCP_relay_Sts 6 "OpenLoad" 5 "SCG" 4 "SCB" 3 "Stuck Closed" 2 "Stuck Open" 1 "closed" 0 "open" ;
VAL_ 520 BMS_QCN_relay_Sts 6 "OpenLoad" 5 "SCG" 4 "SCB" 3 "Stuck Closed" 2 "Stuck Open" 1 "closed" 0 "open" ;
VAL_ 811 BMSH_CHGPrechargeRelaySts 2 "Closed" 1 "Open" 0 "Not Active" ;
VAL_ 1127 DCDC_HvVolt 65535 "Invalid" ;
VAL_ 1127 DCDC_HVCurr 65535 "Invalid" ;
VAL_ 1127 DCDC_LvSideCurr 4095 "Invalid" ;
VAL_ 1127 DCDC_LvSideVolt 2047 "Invalid" ;
VAL_ 1127 DCDC_FaultLevelSts 7 "Reserved" 6 "Reserved" 5 "Reserved" 4 "Lever4 fault(Jetour)" 3 "Lever3 fault" 2 "Lever2 fault" 1 "Lever1 fault" 0 "No fault" ;
VAL_ 1127 DCDC_EnableSts 1 "Enable" 0 "Disable" ;
VAL_ 1127 DCDC_OverTemp 1 "Fault" 0 "No fault" ;
VAL_ 1127 DCDC_LvSideCurrMax 4095 "Invalid" ;
VAL_ 1182 OBC_ChgCurr 65535 "Invalid" ;
VAL_ 1182 OBC_ChgVolt 65535 "Invalid" ;
VAL_ 1182 OBC_MaxOutputPower 255 "Invalid" ;
VAL_ 1182 OBC_CP_DutyCycleValue 255 "Invalid" ;
VAL_ 1182 CDU_Coolanttemp 255 "Invalid" ;
VAL_ 1182 OBC_ChgInterfaceTemp 255 "Invalid" ;
VAL_ 1182 OBC_MaxDisOutPower 255 "Invalid" ;
VAL_ 1182 OBC_CPMaxVolt 255 "Invalid" ;
VAL_ 1182 OBC_ChrgrInputCurr1 1023 "reserved" 1022 "reserved" 1021 "reserved" 1020 "reserved" 1019 "reserved" 1018 "reserved" 1017 "reserved" 1016 "reserved" 1015 "reserved" 1014 "reserved" 1013 "reserved" 1012 "reserved" 1011 "reserved" 1010 "reserved" 1009 "reserved" 1008 "reserved" 1007 "reserved" 1006 "reserved" 1005 "reserved" 1004 "reserved" 1003 "reserved" 1002 "reserved" 1001 "reserved" 1000 "Valid Values" 999 "Valid Values" 998 "Valid Values" 997 "Valid Values" 996 "Valid Values" 995 "Valid Values" 994 "Valid Values" 993 "Valid Values" 992 "Valid Values" 991 "Valid Values" 990 "Valid Values" 989 "Valid Values" 988 "Valid Values" 987 "Valid Values" 986 "Valid Values" 985 "Valid Values" 984 "Valid Values" 983 "Valid Values" 982 "Valid Values" 981 "Valid Values" 980 "Valid Values" 979 "Valid Values" 978 "Valid Values" 977 "Valid Values" 976 "Valid Values" 975 "Valid Values" 974 "Valid Values" 973 "Valid Values" 972 "Valid Values" 971 "Valid Values" 970 "Valid Values" 969 "Valid Values" 968 "Valid Values" 967 "Valid Values" 966 "Valid Values" 965 "Valid Values" 964 "Valid Values" 963 "Valid Values" 962 "Valid Values" 961 "Valid Values" 960 "Valid Values" 959 "Valid Values" 958 "Valid Values" 957 "Valid Values" 956 "Valid Values" 955 "Valid Values" 954 "Valid Values" 953 "Valid Values" 952 "Valid Values" 951 "Valid Values" 950 "Valid Values" 949 "Valid Values" 948 "Valid Values" 947 "Valid Values" 946 "Valid Values" 945 "Valid Values" 944 "Valid Values" 943 "Valid Values" 942 "Valid Values" 941 "Valid Values" 940 "Valid Values" 939 "Valid Values" 938 "Valid Values" 937 "Valid Values" 936 "Valid Values" 935 "Valid Values" 934 "Valid Values" 933 "Valid Values" 932 "Valid Values" 931 "Valid Values" 930 "Valid Values" 929 "Valid Values" 928 "Valid Values" 927 "Valid Values" 926 "Valid Values" 925 "Valid Values" 924 "Valid Values" 923 "Valid Values" 922 "Valid Values" 921 "Valid Values" 920 "Valid Values" 919 "Valid Values" 918 "Valid Values" 917 "Valid Values" 916 "Valid Values" 915 "Valid Values" 914 "Valid Values" 913 "Valid Values" 912 "Valid Values" 911 "Valid Values" 910 "Valid Values" 909 "Valid Values" 908 "Valid Values" 907 "Valid Values" 906 "Valid Values" 905 "Valid Values" 904 "Valid Values" 903 "Valid Values" 902 "Valid Values" 901 "Valid Values" 900 "Valid Values" 899 "Valid Values" 898 "Valid Values" 897 "Valid Values" 896 "Valid Values" 895 "Valid Values" 894 "Valid Values" 893 "Valid Values" 892 "Valid Values" 891 "Valid Values" 890 "Valid Values" 889 "Valid Values" 888 "Valid Values" 887 "Valid Values" 886 "Valid Values" 885 "Valid Values" 884 "Valid Values" 883 "Valid Values" 882 "Valid Values" 881 "Valid Values" 880 "Valid Values" 879 "Valid Values" 878 "Valid Values" 877 "Valid Values" 876 "Valid Values" 875 "Valid Values" 874 "Valid Values" 873 "Valid Values" 872 "Valid Values" 871 "Valid Values" 870 "Valid Values" 869 "Valid Values" 868 "Valid Values" 867 "Valid Values" 866 "Valid Values" 865 "Valid Values" 864 "Valid Values" 863 "Valid Values" 862 "Valid Values" 861 "Valid Values" 860 "Valid Values" 859 "Valid Values" 858 "Valid Values" 857 "Valid Values" 856 "Valid Values" 855 "Valid Values" 854 "Valid Values" 853 "Valid Values" 852 "Valid Values" 851 "Valid Values" 850 "Valid Values" 849 "Valid Values" 848 "Valid Values" 847 "Valid Values" 846 "Valid Values" 845 "Valid Values" 844 "Valid Values" 843 "Valid Values" 842 "Valid Values" 841 "Valid Values" 840 "Valid Values" 839 "Valid Values" 838 "Valid Values" 837 "Valid Values" 836 "Valid Values" 835 "Valid Values" 834 "Valid Values" 833 "Valid Values" 832 "Valid Values" 831 "Valid Values" 830 "Valid Values" 829 "Valid Values" 828 "Valid Values" 827 "Valid Values" 826 "Valid Values" 825 "Valid Values" 824 "Valid Values" 823 "Valid Values" 822 "Valid Values" 821 "Valid Values" 820 "Valid Values" 819 "Valid Values" 818 "Valid Values" 817 "Valid Values" 816 "Valid Values" 815 "Valid Values" 814 "Valid Values" 813 "Valid Values" 812 "Valid Values" 811 "Valid Values" 810 "Valid Values" 809 "Valid Values" 808 "Valid Values" 807 "Valid Values" 806 "Valid Values" 805 "Valid Values" 804 "Valid Values" 803 "Valid Values" 802 "Valid Values" 801 "Valid Values" 800 "Valid Values" 799 "Valid Values" 798 "Valid Values" 797 "Valid Values" 796 "Valid Values" 795 "Valid Values" 794 "Valid Values" 793 "Valid Values" 792 "Valid Values" 791 "Valid Values" 790 "Valid Values" 789 "Valid Values" 788 "Valid Values" 787 "Valid Values" 786 "Valid Values" 785 "Valid Values" 784 "Valid Values" 783 "Valid Values" 782 "Valid Values" 781 "Valid Values" 780 "Valid Values" 779 "Valid Values" 778 "Valid Values" 777 "Valid Values" 776 "Valid Values" 775 "Valid Values" 774 "Valid Values" 773 "Valid Values" 772 "Valid Values" 771 "Valid Values" 770 "Valid Values" 769 "Valid Values" 768 "Valid Values" 767 "Valid Values" 766 "Valid Values" 765 "Valid Values" 764 "Valid Values" 763 "Valid Values" 762 "Valid Values" 761 "Valid Values" 760 "Valid Values" 759 "Valid Values" 758 "Valid Values" 757 "Valid Values" 756 "Valid Values" 755 "Valid Values" 754 "Valid Values" 753 "Valid Values" 752 "Valid Values" 751 "Valid Values" 750 "Valid Values" 749 "Valid Values" 748 "Valid Values" 747 "Valid Values" 746 "Valid Values" 745 "Valid Values" 744 "Valid Values" 743 "Valid Values" 742 "Valid Values" 741 "Valid Values" 740 "Valid Values" 739 "Valid Values" 738 "Valid Values" 737 "Valid Values" 736 "Valid Values" 735 "Valid Values" 734 "Valid Values" 733 "Valid Values" 732 "Valid Values" 731 "Valid Values" 730 "Valid Values" 729 "Valid Values" 728 "Valid Values" 727 "Valid Values" 726 "Valid Values" 725 "Valid Values" 724 "Valid Values" 723 "Valid Values" 722 "Valid Values" 721 "Valid Values" 720 "Valid Values" 719 "Valid Values" 718 "Valid Values" 717 "Valid Values" 716 "Valid Values" 715 "Valid Values" 714 "Valid Values" 713 "Valid Values" 712 "Valid Values" 711 "Valid Values" 710 "Valid Values" 709 "Valid Values" 708 "Valid Values" 707 "Valid Values" 706 "Valid Values" 705 "Valid Values" 704 "Valid Values" 703 "Valid Values" 702 "Valid Values" 701 "Valid Values" 700 "Valid Values" 699 "Valid Values" 698 "Valid Values" 697 "Valid Values" 696 "Valid Values" 695 "Valid Values" 694 "Valid Values" 693 "Valid Values" 692 "Valid Values" 691 "Valid Values" 690 "Valid Values" 689 "Valid Values" 688 "Valid Values" 687 "Valid Values" 686 "Valid Values" 685 "Valid Values" 684 "Valid Values" 683 "Valid Values" 682 "Valid Values" 681 "Valid Values" 680 "Valid Values" 679 "Valid Values" 678 "Valid Values" 677 "Valid Values" 676 "Valid Values" 675 "Valid Values" 674 "Valid Values" 673 "Valid Values" 672 "Valid Values" 671 "Valid Values" 670 "Valid Values" 669 "Valid Values" 668 "Valid Values" 667 "Valid Values" 666 "Valid Values" 665 "Valid Values" 664 "Valid Values" 663 "Valid Values" 662 "Valid Values" 661 "Valid Values" 660 "Valid Values" 659 "Valid Values" 658 "Valid Values" 657 "Valid Values" 656 "Valid Values" 655 "Valid Values" 654 "Valid Values" 653 "Valid Values" 652 "Valid Values" 651 "Valid Values" 650 "Valid Values" 649 "Valid Values" 648 "Valid Values" 647 "Valid Values" 646 "Valid Values" 645 "Valid Values" 644 "Valid Values" 643 "Valid Values" 642 "Valid Values" 641 "Valid Values" 640 "Valid Values" 639 "Valid Values" 638 "Valid Values" 637 "Valid Values" 636 "Valid Values" 635 "Valid Values" 634 "Valid Values" 633 "Valid Values" 632 "Valid Values" 631 "Valid Values" 630 "Valid Values" 629 "Valid Values" 628 "Valid Values" 627 "Valid Values" 626 "Valid Values" 625 "Valid Values" 624 "Valid Values" 623 "Valid Values" 622 "Valid Values" 621 "Valid Values" 620 "Valid Values" 619 "Valid Values" 618 "Valid Values" 617 "Valid Values" 616 "Valid Values" 615 "Valid Values" 614 "Valid Values" 613 "Valid Values" 612 "Valid Values" 611 "Valid Values" 610 "Valid Values" 609 "Valid Values" 608 "Valid Values" 607 "Valid Values" 606 "Valid Values" 605 "Valid Values" 604 "Valid Values" 603 "Valid Values" 602 "Valid Values" 601 "Valid Values" 600 "Valid Values" 599 "Valid Values" 598 "Valid Values" 597 "Valid Values" 596 "Valid Values" 595 "Valid Values" 594 "Valid Values" 593 "Valid Values" 592 "Valid Values" 591 "Valid Values" 590 "Valid Values" 589 "Valid Values" 588 "Valid Values" 587 "Valid Values" 586 "Valid Values" 585 "Valid Values" 584 "Valid Values" 583 "Valid Values" 582 "Valid Values" 581 "Valid Values" 580 "Valid Values" 579 "Valid Values" 578 "Valid Values" 577 "Valid Values" 576 "Valid Values" 575 "Valid Values" 574 "Valid Values" 573 "Valid Values" 572 "Valid Values" 571 "Valid Values" 570 "Valid Values" 569 "Valid Values" 568 "Valid Values" 567 "Valid Values" 566 "Valid Values" 565 "Valid Values" 564 "Valid Values" 563 "Valid Values" 562 "Valid Values" 561 "Valid Values" 560 "Valid Values" 559 "Valid Values" 558 "Valid Values" 557 "Valid Values" 556 "Valid Values" 555 "Valid Values" 554 "Valid Values" 553 "Valid Values" 552 "Valid Values" 551 "Valid Values" 550 "Valid Values" 549 "Valid Values" 548 "Valid Values" 547 "Valid Values" 546 "Valid Values" 545 "Valid Values" 544 "Valid Values" 543 "Valid Values" 542 "Valid Values" 541 "Valid Values" 540 "Valid Values" 539 "Valid Values" 538 "Valid Values" 537 "Valid Values" 536 "Valid Values" 535 "Valid Values" 534 "Valid Values" 533 "Valid Values" 532 "Valid Values" 531 "Valid Values" 530 "Valid Values" 529 "Valid Values" 528 "Valid Values" 527 "Valid Values" 526 "Valid Values" 525 "Valid Values" 524 "Valid Values" 523 "Valid Values" 522 "Valid Values" 521 "Valid Values" 520 "Valid Values" 519 "Valid Values" 518 "Valid Values" 517 "Valid Values" 516 "Valid Values" 515 "Valid Values" 514 "Valid Values" 513 "Valid Values" 512 "Valid Values" 511 "Valid Values" 510 "Valid Values" 509 "Valid Values" 508 "Valid Values" 507 "Valid Values" 506 "Valid Values" 505 "Valid Values" 504 "Valid Values" 503 "Valid Values" 502 "Valid Values" 501 "Valid Values" 500 "Valid Values" 499 "Valid Values" 498 "Valid Values" 497 "Valid Values" 496 "Valid Values" 495 "Valid Values" 494 "Valid Values" 493 "Valid Values" 492 "Valid Values" 491 "Valid Values" 490 "Valid Values" 489 "Valid Values" 488 "Valid Values" 487 "Valid Values" 486 "Valid Values" 485 "Valid Values" 484 "Valid Values" 483 "Valid Values" 482 "Valid Values" 481 "Valid Values" 480 "Valid Values" 479 "Valid Values" 478 "Valid Values" 477 "Valid Values" 476 "Valid Values" 475 "Valid Values" 474 "Valid Values" 473 "Valid Values" 472 "Valid Values" 471 "Valid Values" 470 "Valid Values" 469 "Valid Values" 468 "Valid Values" 467 "Valid Values" 466 "Valid Values" 465 "Valid Values" 464 "Valid Values" 463 "Valid Values" 462 "Valid Values" 461 "Valid Values" 460 "Valid Values" 459 "Valid Values" 458 "Valid Values" 457 "Valid Values" 456 "Valid Values" 455 "Valid Values" 454 "Valid Values" 453 "Valid Values" 452 "Valid Values" 451 "Valid Values" 450 "Valid Values" 449 "Valid Values" 448 "Valid Values" 447 "Valid Values" 446 "Valid Values" 445 "Valid Values" 444 "Valid Values" 443 "Valid Values" 442 "Valid Values" 441 "Valid Values" 440 "Valid Values" 439 "Valid Values" 438 "Valid Values" 437 "Valid Values" 436 "Valid Values" 435 "Valid Values" 434 "Valid Values" 433 "Valid Values" 432 "Valid Values" 431 "Valid Values" 430 "Valid Values" 429 "Valid Values" 428 "Valid Values" 427 "Valid Values" 426 "Valid Values" 425 "Valid Values" 424 "Valid Values" 423 "Valid Values" 422 "Valid Values" 421 "Valid Values" 420 "Valid Values" 419 "Valid Values" 418 "Valid Values" 417 "Valid Values" 416 "Valid Values" 415 "Valid Values" 414 "Valid Values" 413 "Valid Values" 412 "Valid Values" 411 "Valid Values" 410 "Valid Values" 409 "Valid Values" 408 "Valid Values" 407 "Valid Values" 406 "Valid Values" 405 "Valid Values" 404 "Valid Values" 403 "Valid Values" 402 "Valid Values" 401 "Valid Values" 400 "Valid Values" 399 "Valid Values" 398 "Valid Values" 397 "Valid Values" 396 "Valid Values" 395 "Valid Values" 394 "Valid Values" 393 "Valid Values" 392 "Valid Values" 391 "Valid Values" 390 "Valid Values" 389 "Valid Values" 388 "Valid Values" 387 "Valid Values" 386 "Valid Values" 385 "Valid Values" 384 "Valid Values" 383 "Valid Values" 382 "Valid Values" 381 "Valid Values" 380 "Valid Values" 379 "Valid Values" 378 "Valid Values" 377 "Valid Values" 376 "Valid Values" 375 "Valid Values" 374 "Valid Values" 373 "Valid Values" 372 "Valid Values" 371 "Valid Values" 370 "Valid Values" 369 "Valid Values" 368 "Valid Values" 367 "Valid Values" 366 "Valid Values" 365 "Valid Values" 364 "Valid Values" 363 "Valid Values" 362 "Valid Values" 361 "Valid Values" 360 "Valid Values" 359 "Valid Values" 358 "Valid Values" 357 "Valid Values" 356 "Valid Values" 355 "Valid Values" 354 "Valid Values" 353 "Valid Values" 352 "Valid Values" 351 "Valid Values" 350 "Valid Values" 349 "Valid Values" 348 "Valid Values" 347 "Valid Values" 346 "Valid Values" 345 "Valid Values" 344 "Valid Values" 343 "Valid Values" 342 "Valid Values" 341 "Valid Values" 340 "Valid Values" 339 "Valid Values" 338 "Valid Values" 337 "Valid Values" 336 "Valid Values" 335 "Valid Values" 334 "Valid Values" 333 "Valid Values" 332 "Valid Values" 331 "Valid Values" 330 "Valid Values" 329 "Valid Values" 328 "Valid Values" 327 "Valid Values" 326 "Valid Values" 325 "Valid Values" 324 "Valid Values" 323 "Valid Values" 322 "Valid Values" 321 "Valid Values" 320 "Valid Values" 319 "Valid Values" 318 "Valid Values" 317 "Valid Values" 316 "Valid Values" 315 "Valid Values" 314 "Valid Values" 313 "Valid Values" 312 "Valid Values" 311 "Valid Values" 310 "Valid Values" 309 "Valid Values" 308 "Valid Values" 307 "Valid Values" 306 "Valid Values" 305 "Valid Values" 304 "Valid Values" 303 "Valid Values" 302 "Valid Values" 301 "Valid Values" 300 "Valid Values" 299 "Valid Values" 298 "Valid Values" 297 "Valid Values" 296 "Valid Values" 295 "Valid Values" 294 "Valid Values" 293 "Valid Values" 292 "Valid Values" 291 "Valid Values" 290 "Valid Values" 289 "Valid Values" 288 "Valid Values" 287 "Valid Values" 286 "Valid Values" 285 "Valid Values" 284 "Valid Values" 283 "Valid Values" 282 "Valid Values" 281 "Valid Values" 280 "Valid Values" 279 "Valid Values" 278 "Valid Values" 277 "Valid Values" 276 "Valid Values" 275 "Valid Values" 274 "Valid Values" 273 "Valid Values" 272 "Valid Values" 271 "Valid Values" 270 "Valid Values" 269 "Valid Values" 268 "Valid Values" 267 "Valid Values" 266 "Valid Values" 265 "Valid Values" 264 "Valid Values" 263 "Valid Values" 262 "Valid Values" 261 "Valid Values" 260 "Valid Values" 259 "Valid Values" 258 "Valid Values" 257 "Valid Values" 256 "Valid Values" 255 "Valid Values" 254 "Valid Values" 253 "Valid Values" 252 "Valid Values" 251 "Valid Values" 250 "Valid Values" 249 "Valid Values" 248 "Valid Values" 247 "Valid Values" 246 "Valid Values" 245 "Valid Values" 244 "Valid Values" 243 "Valid Values" 242 "Valid Values" 241 "Valid Values" 240 "Valid Values" 239 "Valid Values" 238 "Valid Values" 237 "Valid Values" 236 "Valid Values" 235 "Valid Values" 234 "Valid Values" 233 "Valid Values" 232 "Valid Values" 231 "Valid Values" 230 "Valid Values" 229 "Valid Values" 228 "Valid Values" 227 "Valid Values" 226 "Valid Values" 225 "Valid Values" 224 "Valid Values" 223 "Valid Values" 222 "Valid Values" 221 "Valid Values" 220 "Valid Values" 219 "Valid Values" 218 "Valid Values" 217 "Valid Values" 216 "Valid Values" 215 "Valid Values" 214 "Valid Values" 213 "Valid Values" 212 "Valid Values" 211 "Valid Values" 210 "Valid Values" 209 "Valid Values" 208 "Valid Values" 207 "Valid Values" 206 "Valid Values" 205 "Valid Values" 204 "Valid Values" 203 "Valid Values" 202 "Valid Values" 201 "Valid Values" 200 "Valid Values" 199 "Valid Values" 198 "Valid Values" 197 "Valid Values" 196 "Valid Values" 195 "Valid Values" 194 "Valid Values" 193 "Valid Values" 192 "Valid Values" 191 "Valid Values" 190 "Valid Values" 189 "Valid Values" 188 "Valid Values" 187 "Valid Values" 186 "Valid Values" 185 "Valid Values" 184 "Valid Values" 183 "Valid Values" 182 "Valid Values" 181 "Valid Values" 180 "Valid Values" 179 "Valid Values" 178 "Valid Values" 177 "Valid Values" 176 "Valid Values" 175 "Valid Values" 174 "Valid Values" 173 "Valid Values" 172 "Valid Values" 171 "Valid Values" 170 "Valid Values" 169 "Valid Values" 168 "Valid Values" 167 "Valid Values" 166 "Valid Values" 165 "Valid Values" 164 "Valid Values" 163 "Valid Values" 162 "Valid Values" 161 "Valid Values" 160 "Valid Values" 159 "Valid Values" 158 "Valid Values" 157 "Valid Values" 156 "Valid Values" 155 "Valid Values" 154 "Valid Values" 153 "Valid Values" 152 "Valid Values" 151 "Valid Values" 150 "Valid Values" 149 "Valid Values" 148 "Valid Values" 147 "Valid Values" 146 "Valid Values" 145 "Valid Values" 144 "Valid Values" 143 "Valid Values" 142 "Valid Values" 141 "Valid Values" 140 "Valid Values" 139 "Valid Values" 138 "Valid Values" 137 "Valid Values" 136 "Valid Values" 135 "Valid Values" 134 "Valid Values" 133 "Valid Values" 132 "Valid Values" 131 "Valid Values" 130 "Valid Values" 129 "Valid Values" 128 "Valid Values" 127 "Valid Values" 126 "Valid Values" 125 "Valid Values" 124 "Valid Values" 123 "Valid Values" 122 "Valid Values" 121 "Valid Values" 120 "Valid Values" 119 "Valid Values" 118 "Valid Values" 117 "Valid Values" 116 "Valid Values" 115 "Valid Values" 114 "Valid Values" 113 "Valid Values" 112 "Valid Values" 111 "Valid Values" 110 "Valid Values" 109 "Valid Values" 108 "Valid Values" 107 "Valid Values" 106 "Valid Values" 105 "Valid Values" 104 "Valid Values" 103 "Valid Values" 102 "Valid Values" 101 "Valid Values" 100 "Valid Values" 99 "Valid Values" 98 "Valid Values" 97 "Valid Values" 96 "Valid Values" 95 "Valid Values" 94 "Valid Values" 93 "Valid Values" 92 "Valid Values" 91 "Valid Values" 90 "Valid Values" 89 "Valid Values" 88 "Valid Values" 87 "Valid Values" 86 "Valid Values" 85 "Valid Values" 84 "Valid Values" 83 "Valid Values" 82 "Valid Values" 81 "Valid Values" 80 "Valid Values" 79 "Valid Values" 78 "Valid Values" 77 "Valid Values" 76 "Valid Values" 75 "Valid Values" 74 "Valid Values" 73 "Valid Values" 72 "Valid Values" 71 "Valid Values" 70 "Valid Values" 69 "Valid Values" 68 "Valid Values" 67 "Valid Values" 66 "Valid Values" 65 "Valid Values" 64 "Valid Values" 63 "Valid Values" 62 "Valid Values" 61 "Valid Values" 60 "Valid Values" 59 "Valid Values" 58 "Valid Values" 57 "Valid Values" 56 "Valid Values" 55 "Valid Values" 54 "Valid Values" 53 "Valid Values" 52 "Valid Values" 51 "Valid Values" 50 "Valid Values" 49 "Valid Values" 48 "Valid Values" 47 "Valid Values" 46 "Valid Values" 45 "Valid Values" 44 "Valid Values" 43 "Valid Values" 42 "Valid Values" 41 "Valid Values" 40 "Valid Values" 39 "Valid Values" 38 "Valid Values" 37 "Valid Values" 36 "Valid Values" 35 "Valid Values" 34 "Valid Values" 33 "Valid Values" 32 "Valid Values" 31 "Valid Values" 30 "Valid Values" 29 "Valid Values" 28 "Valid Values" 27 "Valid Values" 26 "Valid Values" 25 "Valid Values" 24 "Valid Values" 23 "Valid Values" 22 "Valid Values" 21 "Valid Values" 20 "Valid Values" 19 "Valid Values" 18 "Valid Values" 17 "Valid Values" 16 "Valid Values" 15 "Valid Values" 14 "Valid Values" 13 "Valid Values" 12 "Valid Values" 11 "Valid Values" 10 "Valid Values" 9 "Valid Values" 8 "Valid Values" 7 "Valid Values" 6 "Valid Values" 5 "Valid Values" 4 "Valid Values" 3 "Valid Values" 2 "Valid Values" 1 "Valid Values" 0 "Valid Values" ;
VAL_ 1182 OBC_ChrgrInputCurr2 1023 "reserved" 1022 "reserved" 1021 "reserved" 1020 "reserved" 1019 "reserved" 1018 "reserved" 1017 "reserved" 1016 "reserved" 1015 "reserved" 1014 "reserved" 1013 "reserved" 1012 "reserved" 1011 "reserved" 1010 "reserved" 1009 "reserved" 1008 "reserved" 1007 "reserved" 1006 "reserved" 1005 "reserved" 1004 "reserved" 1003 "reserved" 1002 "reserved" 1001 "reserved" 1000 "Valid Values" 999 "Valid Values" 998 "Valid Values" 997 "Valid Values" 996 "Valid Values" 995 "Valid Values" 994 "Valid Values" 993 "Valid Values" 992 "Valid Values" 991 "Valid Values" 990 "Valid Values" 989 "Valid Values" 988 "Valid Values" 987 "Valid Values" 986 "Valid Values" 985 "Valid Values" 984 "Valid Values" 983 "Valid Values" 982 "Valid Values" 981 "Valid Values" 980 "Valid Values" 979 "Valid Values" 978 "Valid Values" 977 "Valid Values" 976 "Valid Values" 975 "Valid Values" 974 "Valid Values" 973 "Valid Values" 972 "Valid Values" 971 "Valid Values" 970 "Valid Values" 969 "Valid Values" 968 "Valid Values" 967 "Valid Values" 966 "Valid Values" 965 "Valid Values" 964 "Valid Values" 963 "Valid Values" 962 "Valid Values" 961 "Valid Values" 960 "Valid Values" 959 "Valid Values" 958 "Valid Values" 957 "Valid Values" 956 "Valid Values" 955 "Valid Values" 954 "Valid Values" 953 "Valid Values" 952 "Valid Values" 951 "Valid Values" 950 "Valid Values" 949 "Valid Values" 948 "Valid Values" 947 "Valid Values" 946 "Valid Values" 945 "Valid Values" 944 "Valid Values" 943 "Valid Values" 942 "Valid Values" 941 "Valid Values" 940 "Valid Values" 939 "Valid Values" 938 "Valid Values" 937 "Valid Values" 936 "Valid Values" 935 "Valid Values" 934 "Valid Values" 933 "Valid Values" 932 "Valid Values" 931 "Valid Values" 930 "Valid Values" 929 "Valid Values" 928 "Valid Values" 927 "Valid Values" 926 "Valid Values" 925 "Valid Values" 924 "Valid Values" 923 "Valid Values" 922 "Valid Values" 921 "Valid Values" 920 "Valid Values" 919 "Valid Values" 918 "Valid Values" 917 "Valid Values" 916 "Valid Values" 915 "Valid Values" 914 "Valid Values" 913 "Valid Values" 912 "Valid Values" 911 "Valid Values" 910 "Valid Values" 909 "Valid Values" 908 "Valid Values" 907 "Valid Values" 906 "Valid Values" 905 "Valid Values" 904 "Valid Values" 903 "Valid Values" 902 "Valid Values" 901 "Valid Values" 900 "Valid Values" 899 "Valid Values" 898 "Valid Values" 897 "Valid Values" 896 "Valid Values" 895 "Valid Values" 894 "Valid Values" 893 "Valid Values" 892 "Valid Values" 891 "Valid Values" 890 "Valid Values" 889 "Valid Values" 888 "Valid Values" 887 "Valid Values" 886 "Valid Values" 885 "Valid Values" 884 "Valid Values" 883 "Valid Values" 882 "Valid Values" 881 "Valid Values" 880 "Valid Values" 879 "Valid Values" 878 "Valid Values" 877 "Valid Values" 876 "Valid Values" 875 "Valid Values" 874 "Valid Values" 873 "Valid Values" 872 "Valid Values" 871 "Valid Values" 870 "Valid Values" 869 "Valid Values" 868 "Valid Values" 867 "Valid Values" 866 "Valid Values" 865 "Valid Values" 864 "Valid Values" 863 "Valid Values" 862 "Valid Values" 861 "Valid Values" 860 "Valid Values" 859 "Valid Values" 858 "Valid Values" 857 "Valid Values" 856 "Valid Values" 855 "Valid Values" 854 "Valid Values" 853 "Valid Values" 852 "Valid Values" 851 "Valid Values" 850 "Valid Values" 849 "Valid Values" 848 "Valid Values" 847 "Valid Values" 846 "Valid Values" 845 "Valid Values" 844 "Valid Values" 843 "Valid Values" 842 "Valid Values" 841 "Valid Values" 840 "Valid Values" 839 "Valid Values" 838 "Valid Values" 837 "Valid Values" 836 "Valid Values" 835 "Valid Values" 834 "Valid Values" 833 "Valid Values" 832 "Valid Values" 831 "Valid Values" 830 "Valid Values" 829 "Valid Values" 828 "Valid Values" 827 "Valid Values" 826 "Valid Values" 825 "Valid Values" 824 "Valid Values" 823 "Valid Values" 822 "Valid Values" 821 "Valid Values" 820 "Valid Values" 819 "Valid Values" 818 "Valid Values" 817 "Valid Values" 816 "Valid Values" 815 "Valid Values" 814 "Valid Values" 813 "Valid Values" 812 "Valid Values" 811 "Valid Values" 810 "Valid Values" 809 "Valid Values" 808 "Valid Values" 807 "Valid Values" 806 "Valid Values" 805 "Valid Values" 804 "Valid Values" 803 "Valid Values" 802 "Valid Values" 801 "Valid Values" 800 "Valid Values" 799 "Valid Values" 798 "Valid Values" 797 "Valid Values" 796 "Valid Values" 795 "Valid Values" 794 "Valid Values" 793 "Valid Values" 792 "Valid Values" 791 "Valid Values" 790 "Valid Values" 789 "Valid Values" 788 "Valid Values" 787 "Valid Values" 786 "Valid Values" 785 "Valid Values" 784 "Valid Values" 783 "Valid Values" 782 "Valid Values" 781 "Valid Values" 780 "Valid Values" 779 "Valid Values" 778 "Valid Values" 777 "Valid Values" 776 "Valid Values" 775 "Valid Values" 774 "Valid Values" 773 "Valid Values" 772 "Valid Values" 771 "Valid Values" 770 "Valid Values" 769 "Valid Values" 768 "Valid Values" 767 "Valid Values" 766 "Valid Values" 765 "Valid Values" 764 "Valid Values" 763 "Valid Values" 762 "Valid Values" 761 "Valid Values" 760 "Valid Values" 759 "Valid Values" 758 "Valid Values" 757 "Valid Values" 756 "Valid Values" 755 "Valid Values" 754 "Valid Values" 753 "Valid Values" 752 "Valid Values" 751 "Valid Values" 750 "Valid Values" 749 "Valid Values" 748 "Valid Values" 747 "Valid Values" 746 "Valid Values" 745 "Valid Values" 744 "Valid Values" 743 "Valid Values" 742 "Valid Values" 741 "Valid Values" 740 "Valid Values" 739 "Valid Values" 738 "Valid Values" 737 "Valid Values" 736 "Valid Values" 735 "Valid Values" 734 "Valid Values" 733 "Valid Values" 732 "Valid Values" 731 "Valid Values" 730 "Valid Values" 729 "Valid Values" 728 "Valid Values" 727 "Valid Values" 726 "Valid Values" 725 "Valid Values" 724 "Valid Values" 723 "Valid Values" 722 "Valid Values" 721 "Valid Values" 720 "Valid Values" 719 "Valid Values" 718 "Valid Values" 717 "Valid Values" 716 "Valid Values" 715 "Valid Values" 714 "Valid Values" 713 "Valid Values" 712 "Valid Values" 711 "Valid Values" 710 "Valid Values" 709 "Valid Values" 708 "Valid Values" 707 "Valid Values" 706 "Valid Values" 705 "Valid Values" 704 "Valid Values" 703 "Valid Values" 702 "Valid Values" 701 "Valid Values" 700 "Valid Values" 699 "Valid Values" 698 "Valid Values" 697 "Valid Values" 696 "Valid Values" 695 "Valid Values" 694 "Valid Values" 693 "Valid Values" 692 "Valid Values" 691 "Valid Values" 690 "Valid Values" 689 "Valid Values" 688 "Valid Values" 687 "Valid Values" 686 "Valid Values" 685 "Valid Values" 684 "Valid Values" 683 "Valid Values" 682 "Valid Values" 681 "Valid Values" 680 "Valid Values" 679 "Valid Values" 678 "Valid Values" 677 "Valid Values" 676 "Valid Values" 675 "Valid Values" 674 "Valid Values" 673 "Valid Values" 672 "Valid Values" 671 "Valid Values" 670 "Valid Values" 669 "Valid Values" 668 "Valid Values" 667 "Valid Values" 666 "Valid Values" 665 "Valid Values" 664 "Valid Values" 663 "Valid Values" 662 "Valid Values" 661 "Valid Values" 660 "Valid Values" 659 "Valid Values" 658 "Valid Values" 657 "Valid Values" 656 "Valid Values" 655 "Valid Values" 654 "Valid Values" 653 "Valid Values" 652 "Valid Values" 651 "Valid Values" 650 "Valid Values" 649 "Valid Values" 648 "Valid Values" 647 "Valid Values" 646 "Valid Values" 645 "Valid Values" 644 "Valid Values" 643 "Valid Values" 642 "Valid Values" 641 "Valid Values" 640 "Valid Values" 639 "Valid Values" 638 "Valid Values" 637 "Valid Values" 636 "Valid Values" 635 "Valid Values" 634 "Valid Values" 633 "Valid Values" 632 "Valid Values" 631 "Valid Values" 630 "Valid Values" 629 "Valid Values" 628 "Valid Values" 627 "Valid Values" 626 "Valid Values" 625 "Valid Values" 624 "Valid Values" 623 "Valid Values" 622 "Valid Values" 621 "Valid Values" 620 "Valid Values" 619 "Valid Values" 618 "Valid Values" 617 "Valid Values" 616 "Valid Values" 615 "Valid Values" 614 "Valid Values" 613 "Valid Values" 612 "Valid Values" 611 "Valid Values" 610 "Valid Values" 609 "Valid Values" 608 "Valid Values" 607 "Valid Values" 606 "Valid Values" 605 "Valid Values" 604 "Valid Values" 603 "Valid Values" 602 "Valid Values" 601 "Valid Values" 600 "Valid Values" 599 "Valid Values" 598 "Valid Values" 597 "Valid Values" 596 "Valid Values" 595 "Valid Values" 594 "Valid Values" 593 "Valid Values" 592 "Valid Values" 591 "Valid Values" 590 "Valid Values" 589 "Valid Values" 588 "Valid Values" 587 "Valid Values" 586 "Valid Values" 585 "Valid Values" 584 "Valid Values" 583 "Valid Values" 582 "Valid Values" 581 "Valid Values" 580 "Valid Values" 579 "Valid Values" 578 "Valid Values" 577 "Valid Values" 576 "Valid Values" 575 "Valid Values" 574 "Valid Values" 573 "Valid Values" 572 "Valid Values" 571 "Valid Values" 570 "Valid Values" 569 "Valid Values" 568 "Valid Values" 567 "Valid Values" 566 "Valid Values" 565 "Valid Values" 564 "Valid Values" 563 "Valid Values" 562 "Valid Values" 561 "Valid Values" 560 "Valid Values" 559 "Valid Values" 558 "Valid Values" 557 "Valid Values" 556 "Valid Values" 555 "Valid Values" 554 "Valid Values" 553 "Valid Values" 552 "Valid Values" 551 "Valid Values" 550 "Valid Values" 549 "Valid Values" 548 "Valid Values" 547 "Valid Values" 546 "Valid Values" 545 "Valid Values" 544 "Valid Values" 543 "Valid Values" 542 "Valid Values" 541 "Valid Values" 540 "Valid Values" 539 "Valid Values" 538 "Valid Values" 537 "Valid Values" 536 "Valid Values" 535 "Valid Values" 534 "Valid Values" 533 "Valid Values" 532 "Valid Values" 531 "Valid Values" 530 "Valid Values" 529 "Valid Values" 528 "Valid Values" 527 "Valid Values" 526 "Valid Values" 525 "Valid Values" 524 "Valid Values" 523 "Valid Values" 522 "Valid Values" 521 "Valid Values" 520 "Valid Values" 519 "Valid Values" 518 "Valid Values" 517 "Valid Values" 516 "Valid Values" 515 "Valid Values" 514 "Valid Values" 513 "Valid Values" 512 "Valid Values" 511 "Valid Values" 510 "Valid Values" 509 "Valid Values" 508 "Valid Values" 507 "Valid Values" 506 "Valid Values" 505 "Valid Values" 504 "Valid Values" 503 "Valid Values" 502 "Valid Values" 501 "Valid Values" 500 "Valid Values" 499 "Valid Values" 498 "Valid Values" 497 "Valid Values" 496 "Valid Values" 495 "Valid Values" 494 "Valid Values" 493 "Valid Values" 492 "Valid Values" 491 "Valid Values" 490 "Valid Values" 489 "Valid Values" 488 "Valid Values" 487 "Valid Values" 486 "Valid Values" 485 "Valid Values" 484 "Valid Values" 483 "Valid Values" 482 "Valid Values" 481 "Valid Values" 480 "Valid Values" 479 "Valid Values" 478 "Valid Values" 477 "Valid Values" 476 "Valid Values" 475 "Valid Values" 474 "Valid Values" 473 "Valid Values" 472 "Valid Values" 471 "Valid Values" 470 "Valid Values" 469 "Valid Values" 468 "Valid Values" 467 "Valid Values" 466 "Valid Values" 465 "Valid Values" 464 "Valid Values" 463 "Valid Values" 462 "Valid Values" 461 "Valid Values" 460 "Valid Values" 459 "Valid Values" 458 "Valid Values" 457 "Valid Values" 456 "Valid Values" 455 "Valid Values" 454 "Valid Values" 453 "Valid Values" 452 "Valid Values" 451 "Valid Values" 450 "Valid Values" 449 "Valid Values" 448 "Valid Values" 447 "Valid Values" 446 "Valid Values" 445 "Valid Values" 444 "Valid Values" 443 "Valid Values" 442 "Valid Values" 441 "Valid Values" 440 "Valid Values" 439 "Valid Values" 438 "Valid Values" 437 "Valid Values" 436 "Valid Values" 435 "Valid Values" 434 "Valid Values" 433 "Valid Values" 432 "Valid Values" 431 "Valid Values" 430 "Valid Values" 429 "Valid Values" 428 "Valid Values" 427 "Valid Values" 426 "Valid Values" 425 "Valid Values" 424 "Valid Values" 423 "Valid Values" 422 "Valid Values" 421 "Valid Values" 420 "Valid Values" 419 "Valid Values" 418 "Valid Values" 417 "Valid Values" 416 "Valid Values" 415 "Valid Values" 414 "Valid Values" 413 "Valid Values" 412 "Valid Values" 411 "Valid Values" 410 "Valid Values" 409 "Valid Values" 408 "Valid Values" 407 "Valid Values" 406 "Valid Values" 405 "Valid Values" 404 "Valid Values" 403 "Valid Values" 402 "Valid Values" 401 "Valid Values" 400 "Valid Values" 399 "Valid Values" 398 "Valid Values" 397 "Valid Values" 396 "Valid Values" 395 "Valid Values" 394 "Valid Values" 393 "Valid Values" 392 "Valid Values" 391 "Valid Values" 390 "Valid Values" 389 "Valid Values" 388 "Valid Values" 387 "Valid Values" 386 "Valid Values" 385 "Valid Values" 384 "Valid Values" 383 "Valid Values" 382 "Valid Values" 381 "Valid Values" 380 "Valid Values" 379 "Valid Values" 378 "Valid Values" 377 "Valid Values" 376 "Valid Values" 375 "Valid Values" 374 "Valid Values" 373 "Valid Values" 372 "Valid Values" 371 "Valid Values" 370 "Valid Values" 369 "Valid Values" 368 "Valid Values" 367 "Valid Values" 366 "Valid Values" 365 "Valid Values" 364 "Valid Values" 363 "Valid Values" 362 "Valid Values" 361 "Valid Values" 360 "Valid Values" 359 "Valid Values" 358 "Valid Values" 357 "Valid Values" 356 "Valid Values" 355 "Valid Values" 354 "Valid Values" 353 "Valid Values" 352 "Valid Values" 351 "Valid Values" 350 "Valid Values" 349 "Valid Values" 348 "Valid Values" 347 "Valid Values" 346 "Valid Values" 345 "Valid Values" 344 "Valid Values" 343 "Valid Values" 342 "Valid Values" 341 "Valid Values" 340 "Valid Values" 339 "Valid Values" 338 "Valid Values" 337 "Valid Values" 336 "Valid Values" 335 "Valid Values" 334 "Valid Values" 333 "Valid Values" 332 "Valid Values" 331 "Valid Values" 330 "Valid Values" 329 "Valid Values" 328 "Valid Values" 327 "Valid Values" 326 "Valid Values" 325 "Valid Values" 324 "Valid Values" 323 "Valid Values" 322 "Valid Values" 321 "Valid Values" 320 "Valid Values" 319 "Valid Values" 318 "Valid Values" 317 "Valid Values" 316 "Valid Values" 315 "Valid Values" 314 "Valid Values" 313 "Valid Values" 312 "Valid Values" 311 "Valid Values" 310 "Valid Values" 309 "Valid Values" 308 "Valid Values" 307 "Valid Values" 306 "Valid Values" 305 "Valid Values" 304 "Valid Values" 303 "Valid Values" 302 "Valid Values" 301 "Valid Values" 300 "Valid Values" 299 "Valid Values" 298 "Valid Values" 297 "Valid Values" 296 "Valid Values" 295 "Valid Values" 294 "Valid Values" 293 "Valid Values" 292 "Valid Values" 291 "Valid Values" 290 "Valid Values" 289 "Valid Values" 288 "Valid Values" 287 "Valid Values" 286 "Valid Values" 285 "Valid Values" 284 "Valid Values" 283 "Valid Values" 282 "Valid Values" 281 "Valid Values" 280 "Valid Values" 279 "Valid Values" 278 "Valid Values" 277 "Valid Values" 276 "Valid Values" 275 "Valid Values" 274 "Valid Values" 273 "Valid Values" 272 "Valid Values" 271 "Valid Values" 270 "Valid Values" 269 "Valid Values" 268 "Valid Values" 267 "Valid Values" 266 "Valid Values" 265 "Valid Values" 264 "Valid Values" 263 "Valid Values" 262 "Valid Values" 261 "Valid Values" 260 "Valid Values" 259 "Valid Values" 258 "Valid Values" 257 "Valid Values" 256 "Valid Values" 255 "Valid Values" 254 "Valid Values" 253 "Valid Values" 252 "Valid Values" 251 "Valid Values" 250 "Valid Values" 249 "Valid Values" 248 "Valid Values" 247 "Valid Values" 246 "Valid Values" 245 "Valid Values" 244 "Valid Values" 243 "Valid Values" 242 "Valid Values" 241 "Valid Values" 240 "Valid Values" 239 "Valid Values" 238 "Valid Values" 237 "Valid Values" 236 "Valid Values" 235 "Valid Values" 234 "Valid Values" 233 "Valid Values" 232 "Valid Values" 231 "Valid Values" 230 "Valid Values" 229 "Valid Values" 228 "Valid Values" 227 "Valid Values" 226 "Valid Values" 225 "Valid Values" 224 "Valid Values" 223 "Valid Values" 222 "Valid Values" 221 "Valid Values" 220 "Valid Values" 219 "Valid Values" 218 "Valid Values" 217 "Valid Values" 216 "Valid Values" 215 "Valid Values" 214 "Valid Values" 213 "Valid Values" 212 "Valid Values" 211 "Valid Values" 210 "Valid Values" 209 "Valid Values" 208 "Valid Values" 207 "Valid Values" 206 "Valid Values" 205 "Valid Values" 204 "Valid Values" 203 "Valid Values" 202 "Valid Values" 201 "Valid Values" 200 "Valid Values" 199 "Valid Values" 198 "Valid Values" 197 "Valid Values" 196 "Valid Values" 195 "Valid Values" 194 "Valid Values" 193 "Valid Values" 192 "Valid Values" 191 "Valid Values" 190 "Valid Values" 189 "Valid Values" 188 "Valid Values" 187 "Valid Values" 186 "Valid Values" 185 "Valid Values" 184 "Valid Values" 183 "Valid Values" 182 "Valid Values" 181 "Valid Values" 180 "Valid Values" 179 "Valid Values" 178 "Valid Values" 177 "Valid Values" 176 "Valid Values" 175 "Valid Values" 174 "Valid Values" 173 "Valid Values" 172 "Valid Values" 171 "Valid Values" 170 "Valid Values" 169 "Valid Values" 168 "Valid Values" 167 "Valid Values" 166 "Valid Values" 165 "Valid Values" 164 "Valid Values" 163 "Valid Values" 162 "Valid Values" 161 "Valid Values" 160 "Valid Values" 159 "Valid Values" 158 "Valid Values" 157 "Valid Values" 156 "Valid Values" 155 "Valid Values" 154 "Valid Values" 153 "Valid Values" 152 "Valid Values" 151 "Valid Values" 150 "Valid Values" 149 "Valid Values" 148 "Valid Values" 147 "Valid Values" 146 "Valid Values" 145 "Valid Values" 144 "Valid Values" 143 "Valid Values" 142 "Valid Values" 141 "Valid Values" 140 "Valid Values" 139 "Valid Values" 138 "Valid Values" 137 "Valid Values" 136 "Valid Values" 135 "Valid Values" 134 "Valid Values" 133 "Valid Values" 132 "Valid Values" 131 "Valid Values" 130 "Valid Values" 129 "Valid Values" 128 "Valid Values" 127 "Valid Values" 126 "Valid Values" 125 "Valid Values" 124 "Valid Values" 123 "Valid Values" 122 "Valid Values" 121 "Valid Values" 120 "Valid Values" 119 "Valid Values" 118 "Valid Values" 117 "Valid Values" 116 "Valid Values" 115 "Valid Values" 114 "Valid Values" 113 "Valid Values" 112 "Valid Values" 111 "Valid Values" 110 "Valid Values" 109 "Valid Values" 108 "Valid Values" 107 "Valid Values" 106 "Valid Values" 105 "Valid Values" 104 "Valid Values" 103 "Valid Values" 102 "Valid Values" 101 "Valid Values" 100 "Valid Values" 99 "Valid Values" 98 "Valid Values" 97 "Valid Values" 96 "Valid Values" 95 "Valid Values" 94 "Valid Values" 93 "Valid Values" 92 "Valid Values" 91 "Valid Values" 90 "Valid Values" 89 "Valid Values" 88 "Valid Values" 87 "Valid Values" 86 "Valid Values" 85 "Valid Values" 84 "Valid Values" 83 "Valid Values" 82 "Valid Values" 81 "Valid Values" 80 "Valid Values" 79 "Valid Values" 78 "Valid Values" 77 "Valid Values" 76 "Valid Values" 75 "Valid Values" 74 "Valid Values" 73 "Valid Values" 72 "Valid Values" 71 "Valid Values" 70 "Valid Values" 69 "Valid Values" 68 "Valid Values" 67 "Valid Values" 66 "Valid Values" 65 "Valid Values" 64 "Valid Values" 63 "Valid Values" 62 "Valid Values" 61 "Valid Values" 60 "Valid Values" 59 "Valid Values" 58 "Valid Values" 57 "Valid Values" 56 "Valid Values" 55 "Valid Values" 54 "Valid Values" 53 "Valid Values" 52 "Valid Values" 51 "Valid Values" 50 "Valid Values" 49 "Valid Values" 48 "Valid Values" 47 "Valid Values" 46 "Valid Values" 45 "Valid Values" 44 "Valid Values" 43 "Valid Values" 42 "Valid Values" 41 "Valid Values" 40 "Valid Values" 39 "Valid Values" 38 "Valid Values" 37 "Valid Values" 36 "Valid Values" 35 "Valid Values" 34 "Valid Values" 33 "Valid Values" 32 "Valid Values" 31 "Valid Values" 30 "Valid Values" 29 "Valid Values" 28 "Valid Values" 27 "Valid Values" 26 "Valid Values" 25 "Valid Values" 24 "Valid Values" 23 "Valid Values" 22 "Valid Values" 21 "Valid Values" 20 "Valid Values" 19 "Valid Values" 18 "Valid Values" 17 "Valid Values" 16 "Valid Values" 15 "Valid Values" 14 "Valid Values" 13 "Valid Values" 12 "Valid Values" 11 "Valid Values" 10 "Valid Values" 9 "Valid Values" 8 "Valid Values" 7 "Valid Values" 6 "Valid Values" 5 "Valid Values" 4 "Valid Values" 3 "Valid Values" 2 "Valid Values" 1 "Valid Values" 0 "Valid Values" ;
VAL_ 1182 OBC_ChrgrInputCurr3 1023 "reserved" 1022 "reserved" 1021 "reserved" 1020 "reserved" 1019 "reserved" 1018 "reserved" 1017 "reserved" 1016 "reserved" 1015 "reserved" 1014 "reserved" 1013 "reserved" 1012 "reserved" 1011 "reserved" 1010 "reserved" 1009 "reserved" 1008 "reserved" 1007 "reserved" 1006 "reserved" 1005 "reserved" 1004 "reserved" 1003 "reserved" 1002 "reserved" 1001 "reserved" 1000 "Valid Values" 999 "Valid Values" 998 "Valid Values" 997 "Valid Values" 996 "Valid Values" 995 "Valid Values" 994 "Valid Values" 993 "Valid Values" 992 "Valid Values" 991 "Valid Values" 990 "Valid Values" 989 "Valid Values" 988 "Valid Values" 987 "Valid Values" 986 "Valid Values" 985 "Valid Values" 984 "Valid Values" 983 "Valid Values" 982 "Valid Values" 981 "Valid Values" 980 "Valid Values" 979 "Valid Values" 978 "Valid Values" 977 "Valid Values" 976 "Valid Values" 975 "Valid Values" 974 "Valid Values" 973 "Valid Values" 972 "Valid Values" 971 "Valid Values" 970 "Valid Values" 969 "Valid Values" 968 "Valid Values" 967 "Valid Values" 966 "Valid Values" 965 "Valid Values" 964 "Valid Values" 963 "Valid Values" 962 "Valid Values" 961 "Valid Values" 960 "Valid Values" 959 "Valid Values" 958 "Valid Values" 957 "Valid Values" 956 "Valid Values" 955 "Valid Values" 954 "Valid Values" 953 "Valid Values" 952 "Valid Values" 951 "Valid Values" 950 "Valid Values" 949 "Valid Values" 948 "Valid Values" 947 "Valid Values" 946 "Valid Values" 945 "Valid Values" 944 "Valid Values" 943 "Valid Values" 942 "Valid Values" 941 "Valid Values" 940 "Valid Values" 939 "Valid Values" 938 "Valid Values" 937 "Valid Values" 936 "Valid Values" 935 "Valid Values" 934 "Valid Values" 933 "Valid Values" 932 "Valid Values" 931 "Valid Values" 930 "Valid Values" 929 "Valid Values" 928 "Valid Values" 927 "Valid Values" 926 "Valid Values" 925 "Valid Values" 924 "Valid Values" 923 "Valid Values" 922 "Valid Values" 921 "Valid Values" 920 "Valid Values" 919 "Valid Values" 918 "Valid Values" 917 "Valid Values" 916 "Valid Values" 915 "Valid Values" 914 "Valid Values" 913 "Valid Values" 912 "Valid Values" 911 "Valid Values" 910 "Valid Values" 909 "Valid Values" 908 "Valid Values" 907 "Valid Values" 906 "Valid Values" 905 "Valid Values" 904 "Valid Values" 903 "Valid Values" 902 "Valid Values" 901 "Valid Values" 900 "Valid Values" 899 "Valid Values" 898 "Valid Values" 897 "Valid Values" 896 "Valid Values" 895 "Valid Values" 894 "Valid Values" 893 "Valid Values" 892 "Valid Values" 891 "Valid Values" 890 "Valid Values" 889 "Valid Values" 888 "Valid Values" 887 "Valid Values" 886 "Valid Values" 885 "Valid Values" 884 "Valid Values" 883 "Valid Values" 882 "Valid Values" 881 "Valid Values" 880 "Valid Values" 879 "Valid Values" 878 "Valid Values" 877 "Valid Values" 876 "Valid Values" 875 "Valid Values" 874 "Valid Values" 873 "Valid Values" 872 "Valid Values" 871 "Valid Values" 870 "Valid Values" 869 "Valid Values" 868 "Valid Values" 867 "Valid Values" 866 "Valid Values" 865 "Valid Values" 864 "Valid Values" 863 "Valid Values" 862 "Valid Values" 861 "Valid Values" 860 "Valid Values" 859 "Valid Values" 858 "Valid Values" 857 "Valid Values" 856 "Valid Values" 855 "Valid Values" 854 "Valid Values" 853 "Valid Values" 852 "Valid Values" 851 "Valid Values" 850 "Valid Values" 849 "Valid Values" 848 "Valid Values" 847 "Valid Values" 846 "Valid Values" 845 "Valid Values" 844 "Valid Values" 843 "Valid Values" 842 "Valid Values" 841 "Valid Values" 840 "Valid Values" 839 "Valid Values" 838 "Valid Values" 837 "Valid Values" 836 "Valid Values" 835 "Valid Values" 834 "Valid Values" 833 "Valid Values" 832 "Valid Values" 831 "Valid Values" 830 "Valid Values" 829 "Valid Values" 828 "Valid Values" 827 "Valid Values" 826 "Valid Values" 825 "Valid Values" 824 "Valid Values" 823 "Valid Values" 822 "Valid Values" 821 "Valid Values" 820 "Valid Values" 819 "Valid Values" 818 "Valid Values" 817 "Valid Values" 816 "Valid Values" 815 "Valid Values" 814 "Valid Values" 813 "Valid Values" 812 "Valid Values" 811 "Valid Values" 810 "Valid Values" 809 "Valid Values" 808 "Valid Values" 807 "Valid Values" 806 "Valid Values" 805 "Valid Values" 804 "Valid Values" 803 "Valid Values" 802 "Valid Values" 801 "Valid Values" 800 "Valid Values" 799 "Valid Values" 798 "Valid Values" 797 "Valid Values" 796 "Valid Values" 795 "Valid Values" 794 "Valid Values" 793 "Valid Values" 792 "Valid Values" 791 "Valid Values" 790 "Valid Values" 789 "Valid Values" 788 "Valid Values" 787 "Valid Values" 786 "Valid Values" 785 "Valid Values" 784 "Valid Values" 783 "Valid Values" 782 "Valid Values" 781 "Valid Values" 780 "Valid Values" 779 "Valid Values" 778 "Valid Values" 777 "Valid Values" 776 "Valid Values" 775 "Valid Values" 774 "Valid Values" 773 "Valid Values" 772 "Valid Values" 771 "Valid Values" 770 "Valid Values" 769 "Valid Values" 768 "Valid Values" 767 "Valid Values" 766 "Valid Values" 765 "Valid Values" 764 "Valid Values" 763 "Valid Values" 762 "Valid Values" 761 "Valid Values" 760 "Valid Values" 759 "Valid Values" 758 "Valid Values" 757 "Valid Values" 756 "Valid Values" 755 "Valid Values" 754 "Valid Values" 753 "Valid Values" 752 "Valid Values" 751 "Valid Values" 750 "Valid Values" 749 "Valid Values" 748 "Valid Values" 747 "Valid Values" 746 "Valid Values" 745 "Valid Values" 744 "Valid Values" 743 "Valid Values" 742 "Valid Values" 741 "Valid Values" 740 "Valid Values" 739 "Valid Values" 738 "Valid Values" 737 "Valid Values" 736 "Valid Values" 735 "Valid Values" 734 "Valid Values" 733 "Valid Values" 732 "Valid Values" 731 "Valid Values" 730 "Valid Values" 729 "Valid Values" 728 "Valid Values" 727 "Valid Values" 726 "Valid Values" 725 "Valid Values" 724 "Valid Values" 723 "Valid Values" 722 "Valid Values" 721 "Valid Values" 720 "Valid Values" 719 "Valid Values" 718 "Valid Values" 717 "Valid Values" 716 "Valid Values" 715 "Valid Values" 714 "Valid Values" 713 "Valid Values" 712 "Valid Values" 711 "Valid Values" 710 "Valid Values" 709 "Valid Values" 708 "Valid Values" 707 "Valid Values" 706 "Valid Values" 705 "Valid Values" 704 "Valid Values" 703 "Valid Values" 702 "Valid Values" 701 "Valid Values" 700 "Valid Values" 699 "Valid Values" 698 "Valid Values" 697 "Valid Values" 696 "Valid Values" 695 "Valid Values" 694 "Valid Values" 693 "Valid Values" 692 "Valid Values" 691 "Valid Values" 690 "Valid Values" 689 "Valid Values" 688 "Valid Values" 687 "Valid Values" 686 "Valid Values" 685 "Valid Values" 684 "Valid Values" 683 "Valid Values" 682 "Valid Values" 681 "Valid Values" 680 "Valid Values" 679 "Valid Values" 678 "Valid Values" 677 "Valid Values" 676 "Valid Values" 675 "Valid Values" 674 "Valid Values" 673 "Valid Values" 672 "Valid Values" 671 "Valid Values" 670 "Valid Values" 669 "Valid Values" 668 "Valid Values" 667 "Valid Values" 666 "Valid Values" 665 "Valid Values" 664 "Valid Values" 663 "Valid Values" 662 "Valid Values" 661 "Valid Values" 660 "Valid Values" 659 "Valid Values" 658 "Valid Values" 657 "Valid Values" 656 "Valid Values" 655 "Valid Values" 654 "Valid Values" 653 "Valid Values" 652 "Valid Values" 651 "Valid Values" 650 "Valid Values" 649 "Valid Values" 648 "Valid Values" 647 "Valid Values" 646 "Valid Values" 645 "Valid Values" 644 "Valid Values" 643 "Valid Values" 642 "Valid Values" 641 "Valid Values" 640 "Valid Values" 639 "Valid Values" 638 "Valid Values" 637 "Valid Values" 636 "Valid Values" 635 "Valid Values" 634 "Valid Values" 633 "Valid Values" 632 "Valid Values" 631 "Valid Values" 630 "Valid Values" 629 "Valid Values" 628 "Valid Values" 627 "Valid Values" 626 "Valid Values" 625 "Valid Values" 624 "Valid Values" 623 "Valid Values" 622 "Valid Values" 621 "Valid Values" 620 "Valid Values" 619 "Valid Values" 618 "Valid Values" 617 "Valid Values" 616 "Valid Values" 615 "Valid Values" 614 "Valid Values" 613 "Valid Values" 612 "Valid Values" 611 "Valid Values" 610 "Valid Values" 609 "Valid Values" 608 "Valid Values" 607 "Valid Values" 606 "Valid Values" 605 "Valid Values" 604 "Valid Values" 603 "Valid Values" 602 "Valid Values" 601 "Valid Values" 600 "Valid Values" 599 "Valid Values" 598 "Valid Values" 597 "Valid Values" 596 "Valid Values" 595 "Valid Values" 594 "Valid Values" 593 "Valid Values" 592 "Valid Values" 591 "Valid Values" 590 "Valid Values" 589 "Valid Values" 588 "Valid Values" 587 "Valid Values" 586 "Valid Values" 585 "Valid Values" 584 "Valid Values" 583 "Valid Values" 582 "Valid Values" 581 "Valid Values" 580 "Valid Values" 579 "Valid Values" 578 "Valid Values" 577 "Valid Values" 576 "Valid Values" 575 "Valid Values" 574 "Valid Values" 573 "Valid Values" 572 "Valid Values" 571 "Valid Values" 570 "Valid Values" 569 "Valid Values" 568 "Valid Values" 567 "Valid Values" 566 "Valid Values" 565 "Valid Values" 564 "Valid Values" 563 "Valid Values" 562 "Valid Values" 561 "Valid Values" 560 "Valid Values" 559 "Valid Values" 558 "Valid Values" 557 "Valid Values" 556 "Valid Values" 555 "Valid Values" 554 "Valid Values" 553 "Valid Values" 552 "Valid Values" 551 "Valid Values" 550 "Valid Values" 549 "Valid Values" 548 "Valid Values" 547 "Valid Values" 546 "Valid Values" 545 "Valid Values" 544 "Valid Values" 543 "Valid Values" 542 "Valid Values" 541 "Valid Values" 540 "Valid Values" 539 "Valid Values" 538 "Valid Values" 537 "Valid Values" 536 "Valid Values" 535 "Valid Values" 534 "Valid Values" 533 "Valid Values" 532 "Valid Values" 531 "Valid Values" 530 "Valid Values" 529 "Valid Values" 528 "Valid Values" 527 "Valid Values" 526 "Valid Values" 525 "Valid Values" 524 "Valid Values" 523 "Valid Values" 522 "Valid Values" 521 "Valid Values" 520 "Valid Values" 519 "Valid Values" 518 "Valid Values" 517 "Valid Values" 516 "Valid Values" 515 "Valid Values" 514 "Valid Values" 513 "Valid Values" 512 "Valid Values" 511 "Valid Values" 510 "Valid Values" 509 "Valid Values" 508 "Valid Values" 507 "Valid Values" 506 "Valid Values" 505 "Valid Values" 504 "Valid Values" 503 "Valid Values" 502 "Valid Values" 501 "Valid Values" 500 "Valid Values" 499 "Valid Values" 498 "Valid Values" 497 "Valid Values" 496 "Valid Values" 495 "Valid Values" 494 "Valid Values" 493 "Valid Values" 492 "Valid Values" 491 "Valid Values" 490 "Valid Values" 489 "Valid Values" 488 "Valid Values" 487 "Valid Values" 486 "Valid Values" 485 "Valid Values" 484 "Valid Values" 483 "Valid Values" 482 "Valid Values" 481 "Valid Values" 480 "Valid Values" 479 "Valid Values" 478 "Valid Values" 477 "Valid Values" 476 "Valid Values" 475 "Valid Values" 474 "Valid Values" 473 "Valid Values" 472 "Valid Values" 471 "Valid Values" 470 "Valid Values" 469 "Valid Values" 468 "Valid Values" 467 "Valid Values" 466 "Valid Values" 465 "Valid Values" 464 "Valid Values" 463 "Valid Values" 462 "Valid Values" 461 "Valid Values" 460 "Valid Values" 459 "Valid Values" 458 "Valid Values" 457 "Valid Values" 456 "Valid Values" 455 "Valid Values" 454 "Valid Values" 453 "Valid Values" 452 "Valid Values" 451 "Valid Values" 450 "Valid Values" 449 "Valid Values" 448 "Valid Values" 447 "Valid Values" 446 "Valid Values" 445 "Valid Values" 444 "Valid Values" 443 "Valid Values" 442 "Valid Values" 441 "Valid Values" 440 "Valid Values" 439 "Valid Values" 438 "Valid Values" 437 "Valid Values" 436 "Valid Values" 435 "Valid Values" 434 "Valid Values" 433 "Valid Values" 432 "Valid Values" 431 "Valid Values" 430 "Valid Values" 429 "Valid Values" 428 "Valid Values" 427 "Valid Values" 426 "Valid Values" 425 "Valid Values" 424 "Valid Values" 423 "Valid Values" 422 "Valid Values" 421 "Valid Values" 420 "Valid Values" 419 "Valid Values" 418 "Valid Values" 417 "Valid Values" 416 "Valid Values" 415 "Valid Values" 414 "Valid Values" 413 "Valid Values" 412 "Valid Values" 411 "Valid Values" 410 "Valid Values" 409 "Valid Values" 408 "Valid Values" 407 "Valid Values" 406 "Valid Values" 405 "Valid Values" 404 "Valid Values" 403 "Valid Values" 402 "Valid Values" 401 "Valid Values" 400 "Valid Values" 399 "Valid Values" 398 "Valid Values" 397 "Valid Values" 396 "Valid Values" 395 "Valid Values" 394 "Valid Values" 393 "Valid Values" 392 "Valid Values" 391 "Valid Values" 390 "Valid Values" 389 "Valid Values" 388 "Valid Values" 387 "Valid Values" 386 "Valid Values" 385 "Valid Values" 384 "Valid Values" 383 "Valid Values" 382 "Valid Values" 381 "Valid Values" 380 "Valid Values" 379 "Valid Values" 378 "Valid Values" 377 "Valid Values" 376 "Valid Values" 375 "Valid Values" 374 "Valid Values" 373 "Valid Values" 372 "Valid Values" 371 "Valid Values" 370 "Valid Values" 369 "Valid Values" 368 "Valid Values" 367 "Valid Values" 366 "Valid Values" 365 "Valid Values" 364 "Valid Values" 363 "Valid Values" 362 "Valid Values" 361 "Valid Values" 360 "Valid Values" 359 "Valid Values" 358 "Valid Values" 357 "Valid Values" 356 "Valid Values" 355 "Valid Values" 354 "Valid Values" 353 "Valid Values" 352 "Valid Values" 351 "Valid Values" 350 "Valid Values" 349 "Valid Values" 348 "Valid Values" 347 "Valid Values" 346 "Valid Values" 345 "Valid Values" 344 "Valid Values" 343 "Valid Values" 342 "Valid Values" 341 "Valid Values" 340 "Valid Values" 339 "Valid Values" 338 "Valid Values" 337 "Valid Values" 336 "Valid Values" 335 "Valid Values" 334 "Valid Values" 333 "Valid Values" 332 "Valid Values" 331 "Valid Values" 330 "Valid Values" 329 "Valid Values" 328 "Valid Values" 327 "Valid Values" 326 "Valid Values" 325 "Valid Values" 324 "Valid Values" 323 "Valid Values" 322 "Valid Values" 321 "Valid Values" 320 "Valid Values" 319 "Valid Values" 318 "Valid Values" 317 "Valid Values" 316 "Valid Values" 315 "Valid Values" 314 "Valid Values" 313 "Valid Values" 312 "Valid Values" 311 "Valid Values" 310 "Valid Values" 309 "Valid Values" 308 "Valid Values" 307 "Valid Values" 306 "Valid Values" 305 "Valid Values" 304 "Valid Values" 303 "Valid Values" 302 "Valid Values" 301 "Valid Values" 300 "Valid Values" 299 "Valid Values" 298 "Valid Values" 297 "Valid Values" 296 "Valid Values" 295 "Valid Values" 294 "Valid Values" 293 "Valid Values" 292 "Valid Values" 291 "Valid Values" 290 "Valid Values" 289 "Valid Values" 288 "Valid Values" 287 "Valid Values" 286 "Valid Values" 285 "Valid Values" 284 "Valid Values" 283 "Valid Values" 282 "Valid Values" 281 "Valid Values" 280 "Valid Values" 279 "Valid Values" 278 "Valid Values" 277 "Valid Values" 276 "Valid Values" 275 "Valid Values" 274 "Valid Values" 273 "Valid Values" 272 "Valid Values" 271 "Valid Values" 270 "Valid Values" 269 "Valid Values" 268 "Valid Values" 267 "Valid Values" 266 "Valid Values" 265 "Valid Values" 264 "Valid Values" 263 "Valid Values" 262 "Valid Values" 261 "Valid Values" 260 "Valid Values" 259 "Valid Values" 258 "Valid Values" 257 "Valid Values" 256 "Valid Values" 255 "Valid Values" 254 "Valid Values" 253 "Valid Values" 252 "Valid Values" 251 "Valid Values" 250 "Valid Values" 249 "Valid Values" 248 "Valid Values" 247 "Valid Values" 246 "Valid Values" 245 "Valid Values" 244 "Valid Values" 243 "Valid Values" 242 "Valid Values" 241 "Valid Values" 240 "Valid Values" 239 "Valid Values" 238 "Valid Values" 237 "Valid Values" 236 "Valid Values" 235 "Valid Values" 234 "Valid Values" 233 "Valid Values" 232 "Valid Values" 231 "Valid Values" 230 "Valid Values" 229 "Valid Values" 228 "Valid Values" 227 "Valid Values" 226 "Valid Values" 225 "Valid Values" 224 "Valid Values" 223 "Valid Values" 222 "Valid Values" 221 "Valid Values" 220 "Valid Values" 219 "Valid Values" 218 "Valid Values" 217 "Valid Values" 216 "Valid Values" 215 "Valid Values" 214 "Valid Values" 213 "Valid Values" 212 "Valid Values" 211 "Valid Values" 210 "Valid Values" 209 "Valid Values" 208 "Valid Values" 207 "Valid Values" 206 "Valid Values" 205 "Valid Values" 204 "Valid Values" 203 "Valid Values" 202 "Valid Values" 201 "Valid Values" 200 "Valid Values" 199 "Valid Values" 198 "Valid Values" 197 "Valid Values" 196 "Valid Values" 195 "Valid Values" 194 "Valid Values" 193 "Valid Values" 192 "Valid Values" 191 "Valid Values" 190 "Valid Values" 189 "Valid Values" 188 "Valid Values" 187 "Valid Values" 186 "Valid Values" 185 "Valid Values" 184 "Valid Values" 183 "Valid Values" 182 "Valid Values" 181 "Valid Values" 180 "Valid Values" 179 "Valid Values" 178 "Valid Values" 177 "Valid Values" 176 "Valid Values" 175 "Valid Values" 174 "Valid Values" 173 "Valid Values" 172 "Valid Values" 171 "Valid Values" 170 "Valid Values" 169 "Valid Values" 168 "Valid Values" 167 "Valid Values" 166 "Valid Values" 165 "Valid Values" 164 "Valid Values" 163 "Valid Values" 162 "Valid Values" 161 "Valid Values" 160 "Valid Values" 159 "Valid Values" 158 "Valid Values" 157 "Valid Values" 156 "Valid Values" 155 "Valid Values" 154 "Valid Values" 153 "Valid Values" 152 "Valid Values" 151 "Valid Values" 150 "Valid Values" 149 "Valid Values" 148 "Valid Values" 147 "Valid Values" 146 "Valid Values" 145 "Valid Values" 144 "Valid Values" 143 "Valid Values" 142 "Valid Values" 141 "Valid Values" 140 "Valid Values" 139 "Valid Values" 138 "Valid Values" 137 "Valid Values" 136 "Valid Values" 135 "Valid Values" 134 "Valid Values" 133 "Valid Values" 132 "Valid Values" 131 "Valid Values" 130 "Valid Values" 129 "Valid Values" 128 "Valid Values" 127 "Valid Values" 126 "Valid Values" 125 "Valid Values" 124 "Valid Values" 123 "Valid Values" 122 "Valid Values" 121 "Valid Values" 120 "Valid Values" 119 "Valid Values" 118 "Valid Values" 117 "Valid Values" 116 "Valid Values" 115 "Valid Values" 114 "Valid Values" 113 "Valid Values" 112 "Valid Values" 111 "Valid Values" 110 "Valid Values" 109 "Valid Values" 108 "Valid Values" 107 "Valid Values" 106 "Valid Values" 105 "Valid Values" 104 "Valid Values" 103 "Valid Values" 102 "Valid Values" 101 "Valid Values" 100 "Valid Values" 99 "Valid Values" 98 "Valid Values" 97 "Valid Values" 96 "Valid Values" 95 "Valid Values" 94 "Valid Values" 93 "Valid Values" 92 "Valid Values" 91 "Valid Values" 90 "Valid Values" 89 "Valid Values" 88 "Valid Values" 87 "Valid Values" 86 "Valid Values" 85 "Valid Values" 84 "Valid Values" 83 "Valid Values" 82 "Valid Values" 81 "Valid Values" 80 "Valid Values" 79 "Valid Values" 78 "Valid Values" 77 "Valid Values" 76 "Valid Values" 75 "Valid Values" 74 "Valid Values" 73 "Valid Values" 72 "Valid Values" 71 "Valid Values" 70 "Valid Values" 69 "Valid Values" 68 "Valid Values" 67 "Valid Values" 66 "Valid Values" 65 "Valid Values" 64 "Valid Values" 63 "Valid Values" 62 "Valid Values" 61 "Valid Values" 60 "Valid Values" 59 "Valid Values" 58 "Valid Values" 57 "Valid Values" 56 "Valid Values" 55 "Valid Values" 54 "Valid Values" 53 "Valid Values" 52 "Valid Values" 51 "Valid Values" 50 "Valid Values" 49 "Valid Values" 48 "Valid Values" 47 "Valid Values" 46 "Valid Values" 45 "Valid Values" 44 "Valid Values" 43 "Valid Values" 42 "Valid Values" 41 "Valid Values" 40 "Valid Values" 39 "Valid Values" 38 "Valid Values" 37 "Valid Values" 36 "Valid Values" 35 "Valid Values" 34 "Valid Values" 33 "Valid Values" 32 "Valid Values" 31 "Valid Values" 30 "Valid Values" 29 "Valid Values" 28 "Valid Values" 27 "Valid Values" 26 "Valid Values" 25 "Valid Values" 24 "Valid Values" 23 "Valid Values" 22 "Valid Values" 21 "Valid Values" 20 "Valid Values" 19 "Valid Values" 18 "Valid Values" 17 "Valid Values" 16 "Valid Values" 15 "Valid Values" 14 "Valid Values" 13 "Valid Values" 12 "Valid Values" 11 "Valid Values" 10 "Valid Values" 9 "Valid Values" 8 "Valid Values" 7 "Valid Values" 6 "Valid Values" 5 "Valid Values" 4 "Valid Values" 3 "Valid Values" 2 "Valid Values" 1 "Valid Values" 0 "Valid Values" ;
VAL_ 1182 OBC_S2Swtsts 3 "Error" 2 "reserved" 1 "close" 0 "open" ;
